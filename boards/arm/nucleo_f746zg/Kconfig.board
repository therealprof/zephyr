## boards/arm/nucleo_f746zg/Kconfig.board
```kconfig
# Kconfig - Nucleo-F746ZG board configuration
#
# Copyright (c) 2018 Daniel Egger
#
# SPDX-License-Identifier: Apache-2.0
#

config BOARD_NUCLEO_F746ZG
	bool "Nucleo-F746ZG Development Board"
	depends on SOC_STM32F746XG
```

## boards/arm/nucleo_f746zg/Kconfig.defconfig
```kconfig
# Kconfig - Nucleo F746G board configuration
#
# Copyright (c) 2018 Daniel Egger
#
# SPDX-License-Identifier: Apache-2.0
#

if BOARD_NUCLEO_F746ZG

config BOARD
	default "nucleo_f746zg"

if UART_CONSOLE

config UART_STM32_PORT_3
	default y

endif # UART_CONSOLE

if NETWORKING

config NET_L2_ETHERNET
	def_bool y

config ETH_STM32_HAL
	def_bool y

endif # NETWORKING

endif # BOARD_NUCLEO_F746ZG
```
